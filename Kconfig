## drivers/motor/Kconfig
```kconfig
# SPDX-License-Identifier: Apache-2.0

config LONG_MOTOR
	bool "Long EDC Motor driver with PID speed loop"
	default y
	depends on DT_HAS_LONG_MOTOR_ENABLED
	select PWM
	help
	  Motor driver combining PWM speed control, direction GPIO,
	  and QDEC encoder feedback with a built-in PID speed controller.
	  gear-ratio is read from devicetree; PID parameters are injected
	  at runtime via motor_init().

if LONG_MOTOR

config MOTOR_INIT_PRIORITY
	int "Motor driver init priority"
	default 95
	help
	  POST_KERNEL init priority. Must be higher than SENSOR (90).

config MOTOR_LOG_LEVEL
	int "Motor driver log level"
	default 3
	range 0 4
	help
	  0=ERR, 1=WRN, 2=INF, 3=DBG, 4=NONE (Zephyr LOG_LEVEL semantic)

endif # LONG_MOTOR
```

## drivers/sensor/line_sensor/Kconfig
```kconfig
# SPDX-License-Identifier: Apache-2.0

config LONG_LINE_SENSOR
	bool "Long Line Sensor — 4051 mux + ADC grayscale sensor"
	default y
	depends on DT_HAS_LONG_LINE_SENSOR_ENABLED && ADC
	help
	  8-channel grayscale line sensor via 4051 analog multiplexer + ADC.
	  Supports white/black calibration, normalization (0-1000),
	  and binary thresholding with hysteresis.
```

## drivers/sensor/long_icm45686/Kconfig
```kconfig
# SPDX-License-Identifier: Apache-2.0

config LONG_ICM45686
	bool "Long ICM45686 IMU with integrated VQF orientation filter"
	default y
	depends on DT_HAS_LONG_ICM45686_ENABLED && I2C
	help
	  ICM45686 6-axis IMU driver with integrated VQF (Versatile Quaternion
	  Filter) sensor fusion. Uses the sensor's internal 32kHz RC oscillator
	  — no external crystal required. Outputs orientation (roll/pitch/yaw
	  in degrees) and debiased angular velocity (rad/s) via the Zephyr
	  sensor API.

	  ODR is 100 Hz, suitable for M0+/M4 MCUs without FPU.
	  VQF runs in single-precision (float) mode.
```

## drivers/sensor/long_qdec/Kconfig
```kconfig
# SPDX-License-Identifier: Apache-2.0

config LONG_QDEC
	bool "Long QDEC — GPIO-based Quadrature Decoder"
	default y
	depends on DT_HAS_LONG_QDEC_ENABLED
	help
	  Quadrature decoder sensor using one GPIO interrupt pin (channel A)
	  and one GPIO input pin (channel B). Decodes at 2x resolution by
	  reading channel B on each edge of channel A.

config LONG_QDEC_AVG_TAP
	int "Number of edges averaged for RPM (sliding window)"
	default 8
	range 1 32
	depends on LONG_QDEC
	help
	  Sliding-window size N for period-method RPM. Each ISR pushes the
	  latest edge interval into an N-deep ring; RPM is computed from the
	  N-edge average, damping per-edge ISR jitter by ~N. Larger N = smoother
	  RPM but more lag at low speed (window spans N edges). At 11ppr 4x
	  there are 44 edges/rev, so N=8 spans ~0.18 rev. N=1 reproduces the
	  single-point T-method. Every valid edge is pushed regardless of
	  interval (idle is judged in fetch, not ISR) so low speed / restart
	  never starves the window.
```

## dts/bindings/sensor/long-icm45686.yaml
```yaml
# SPDX-License-Identifier: Apache-2.0

description: ICM45686 6-axis IMU sensor driver with integrated VQF orientation filter

compatible: "long-icm45686"

include: [sensor-device.yaml, i2c-device.yaml]

properties:
  int1-gpios:
    type: phandle-array
    required: false
    description: |
      INT1 pin from ICM45686 (optional).
      When connected, used for FIFO watermark interrupt.
      When not connected, driver uses polling mode via sample_fetch.
```

## dts/bindings/sensor/long-line-sensor.yaml
```yaml
# SPDX-License-Identifier: Apache-2.0

description: |
  Long EDC Line Sensor driver — 4051 analog multiplexer + ADC.
  8-channel grayscale sensor for line-following robots.

  S0/S1/S2 address lines switch the 4051 channel, ADC reads the
  selected sensor. The driver handles mux switching, multi-sample
  averaging, calibration (white/black), normalization, and
  binary thresholding.

  Example usage:

      line_sensor: line_sensor {
          compatible = "long-line-sensor";
          io-channels = <&adc0 7>;
          mux-gpios = <&gpiob 3 GPIO_ACTIVE_HIGH>,
                       <&gpioa 8 GPIO_ACTIVE_HIGH>,
                       <&gpioa 9 GPIO_ACTIVE_HIGH>;
          num-sensors = <8>;
      };

compatible: "long-line-sensor"

include: sensor-device.yaml

properties:
  io-channels:
    type: phandle-array
    required: true
    description: |
      ADC channel for the mux output. Single phandle-array pointing
      to the ADC instance and its input channel.

  mux-gpios:
    type: phandle-array
    required: true
    description: |
      Three GPIOs for the 4051 address lines: S0 (LSB), S1, S2 (MSB).

  num-sensors:
    type: int
    required: true
    default: 8
    description: Number of connected sensors (1–8).
```

## dts/bindings/sensor/long-qdec.yaml
```yaml
# SPDX-License-Identifier: Apache-2.0

description: |
  GPIO-based quadrature decoder (QDEC) sensor.
  Uses one GPIO interrupt (channel A) and one GPIO input (channel B)
  to decode quadrature encoder signals at 2x resolution.

compatible: "long-qdec"

include: sensor-device.yaml

properties:
  a-gpios:
    type: phandle-array
    required: true
    description: |
      Channel A — interrupt pin, configured for both-edge triggering.

  b-gpios:
    type: phandle-array
    required: true
    description: |
      Channel B — read-only input, sampled in the ISR to determine direction.

  pulses-per-rev:
    type: int
    default: 1
    description: |
      Number of pulses (full quadrature cycles) per revolution.
      Set to 0 to get raw step counts.

  output-reversed:
    type: boolean
    description: |
      反转编码器输出方向。当编码器物理转向与系统期望的正方向相反时置位
      （例如电机正转时编码器读数为负）。在 ISR 源头取反 delta，
      ROTATION/RPM 符号随之反转，所有消费者（motor PID、距离累积等）
      无需各自处理方向。
```

## west.yml
```yaml
manifest:
  remotes:
    - name: ti-msp
      url-base: https://github.com/TexasInstruments

  projects:
    - name: zephyr
      remote: ti-msp
      repo-path: msp-zephyr
      revision: f8fc554b7a9efe191e957821e91ad0c22024ac0d
      import: true
```
